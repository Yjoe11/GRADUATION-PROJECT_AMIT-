/*
 * ULTRASONIC.c
 *
 * Created: 3/9/2022 5:14:25 PM
 *  Author: alkods
 */ 


#include "ULTRASONIC_02.h"


uint8 SENSOR_02_TRIGGERED = 0 ;
uint8 STARTING_02_PULSE = 0 ;
uint8 TIMER_COUNTER_02 = 0 ;

uint32 DISTANCE_02 = 0;


void (*CALLBACK_PTR_ult_02) (uint32 val) = 0;

void ULTRASONIC_02_INIT(void)
{
	//LCD_Init();
	//LCD_Clear();
	//LCD_WriteString("distance");
	//SET_BIT(TRIGGER_DDR, TRIGGER);
	DIO_SetPinDir(TRIGGER_PORT, TRIGGER, DIO_PIN_OUTPUT);
	//CLR_BIT(ECHO_DDR, ECHO);
	DIO_SetPinDir(ECHO_PORT, ECHO, DIO_PIN_INPUT);
	//SET_BIT(ECHO_PORT, ECHO);
	SET_PULL_UP_RESESTOR(ECHO_PORT, ECHO);
	EXTERNAL_INT1_INIT();
	TIMER_0_INIT();
	EXTERNAL_INIT1_SET_CALLBACK(ULTRASONIC_02_EXT_INT);
	TIMER_0_INIT_SET_CALLBACK(ULTRASONIC_02_OVF_INT);
}

void ULTRASONIC_02_TREGGIER(void)
{
	if (!SENSOR_02_TRIGGERED)
	{
		//SET_BIT(TRIGGER_PORT, TRIGGER);
		DIO_SetPinVal(TRIGGER_PORT, TRIGGER, DIO_PIN_HIGH);
		_delay_us(10);
		//CLR_BIT(TRIGGER_PORT, TRIGGER);
		DIO_SetPinVal(TRIGGER_PORT, TRIGGER, DIO_PIN_LOW);
		SENSOR_02_TRIGGERED = 1 ;
	}
}

void ULTRASONIC_02_ACTION_SET_CALLBACK( void (*COPY_FUNCTION) (uint32 DISTANCE))
{
	CALLBACK_PTR_ult_02 = COPY_FUNCTION;
	
}

void ULTRASONIC_02_EXT_INT(void)
{
	//LCD_WriteString("CM");
	if (SENSOR_02_TRIGGERED == 1)
	{
		if (STARTING_02_PULSE == 0)
		{
			TIMER_0_START();
			TCNT0 = 0x00;
			STARTING_02_PULSE = 1;
			TIMER_COUNTER_02 = 0;
		}
		else
		{
			DISTANCE_02 = ((TIMER_COUNTER_02 * 256) + TCNT0) * (64 / 58);
			if(CALLBACK_PTR_ult_02 != 0)
			{
				CALLBACK_PTR_ult_02(DISTANCE_02);
			}
			_delay_us(5);
			TCNT0 = 0x00 ;
			STARTING_02_PULSE = 0;
			TIMER_COUNTER_02 = 0;
			SENSOR_02_TRIGGERED = 0;
		}
	}
}

void ULTRASONIC_02_OVF_INT(void)
{
	TIMER_COUNTER_02++;
	//LCD_WriteString("CM");
	if (TIMER_COUNTER_02 > 362)
	{
		TIMER_0_STOP() ;
		TCNT0 = 0x00 ;
		SENSOR_02_TRIGGERED = 0;
		STARTING_02_PULSE = 0;
		TIMER_COUNTER_02 = 0;
	}
}



